## config/west.yml
```yaml
manifest:
  remotes:
    - name: moergo-sc
      url-base: https://github.com/moergo-sc
  projects:
    - name: zmk
      remote: moergo-sc
      revision: moergo-sc/zmk/pull/36
      import: app/west.yml
  self:
    path: config
```
